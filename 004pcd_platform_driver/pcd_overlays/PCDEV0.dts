/dts-v1/;
/plugin/;

/{
    fragment@0 {
        target = <&pcdev1>;
        __overlay__{
            status = "disabled";
        };
    };

    fragment@1 {
        target = <&pcdev2>;
        __overlay__{
            personal,size = <2048>;
            personal,permission = <0x11>;
        };
    };
};